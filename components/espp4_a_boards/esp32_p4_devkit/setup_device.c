#include <string.h>
#include "freertos/FreeRTOS.h"
#include "freertos/task.h"
#include "driver/gpio.h"
#include "esp_log.h"
#include "esp_check.h"
#include "esp_lcd_panel_ops.h"
#include "esp_board_manager_includes.h"
#if __has_include(<esp_lcd_touch_st7123.h>)
#define HAS_ST7123 1
#include "esp_lcd_touch_st7123.h"
#endif

static const char *TAG = "P4_A_DEVKIT_SETUP_DEVICE";

#define LCD_RST_GPIO 46
#define TP_RST_GPIO  47  // Display and touch share one TDDI chip, keep touch reset high once released.

// ST7102 init sequence from the panel vendor (r050hx_st7102_480x854.c).
typedef struct {
    uint8_t cmd;
    const uint8_t *data;
    uint8_t len;
    uint16_t delay_ms;
} lcd_init_cmd_t;

static const lcd_init_cmd_t init_cmds[] = {
    {0x10, NULL, 0, 5},
    {0x28, NULL, 0, 5},
    {0x99, (uint8_t[]){0x71, 0x02, 0xa2}, 3, 0},
    {0x99, (uint8_t[]){0x71, 0x02, 0xa3}, 3, 0},
    {0x99, (uint8_t[]){0x71, 0x02, 0xa4}, 3, 0},
    {0xA4, (uint8_t[]){0x31}, 1, 0},
    {0xB0, (uint8_t[]){0x22, 0x6B, 0x1E, 0x75, 0x2F, 0x39, 0x43}, 7, 0},
    {0xB7, (uint8_t[]){0x7D, 0x7D}, 2, 0},
    {0xBF, (uint8_t[]){0x90, 0x90}, 2, 0},
    {0xBA, (uint8_t[]){0x72, 0x76, 0x52, 0xD6, 0xC0, 0x20, 0x00, 0x00}, 8, 0},
    {0xD7, (uint8_t[]){0x00, 0x0B, 0xC6, 0x19, 0xAB, 0xAB}, 6, 0},
    {0xA3, (uint8_t[]){0x51, 0x03, 0x88, 0x00, 0x44, 0x00, 0x00, 0x00, 0x00, 0x04, 0x5C, 0xCF, 0x00, 0x1A, 0x00, 0x45,
                       0x05, 0x00, 0x00, 0x00, 0x00, 0x46, 0x00, 0x00, 0x02, 0x20, 0x52, 0x00, 0x00, 0x00, 0x00, 0xFF}, 32, 0},
    {0xA7, (uint8_t[]){0x19, 0x19, 0x00, 0x64, 0x40, 0x05, 0x14, 0x40, 0x00, 0x04, 0x03, 0xCF, 0xCF, 0x00, 0x64, 0x40,
                       0x23, 0x67, 0x01, 0x00, 0x02, 0x00, 0xCF, 0xCF, 0x00, 0x64, 0x40, 0x4B, 0x5A, 0x00, 0x00, 0x02,
                       0x01, 0xCF, 0xCF, 0x00, 0x24, 0x40, 0x69, 0x78, 0x00, 0x00, 0x00, 0x00, 0xCF, 0xCF, 0x00, 0x44}, 48, 0},
    {0xA6, (uint8_t[]){0x30, 0x00, 0x24, 0x77, 0x36, 0x00, 0x37, 0x00, 0x5C, 0xCF, 0x02, 0xE4, 0x99, 0x00, 0x0B, 0x00,
                       0x0B, 0xCF, 0x5C, 0x02, 0xA4, 0x11, 0x00, 0x00, 0x00, 0x00, 0x5C, 0xCF, 0x00, 0xAC, 0x11, 0x00,
                       0x00, 0x00, 0x00, 0x5C, 0xCF, 0x00, 0x00, 0x06, 0x00, 0x00, 0x00, 0x00}, 44, 0},
    {0xA7, (uint8_t[]){0x19, 0x19, 0x00, 0x64, 0x40, 0x05, 0x14, 0x40, 0x00, 0x04, 0x03, 0x5C, 0xCF, 0x00, 0x64, 0x40,
                       0x23, 0x67, 0x01, 0x00, 0x02, 0x00, 0x5C, 0xCF, 0x00, 0x64, 0x40, 0x4B, 0x5A, 0x00, 0x00, 0x02,
                       0x01, 0x5C, 0xCF, 0x00, 0x24, 0x40, 0x69, 0x78, 0x00, 0x00, 0x00, 0x00, 0x5C, 0xCF, 0x00, 0x44}, 48, 0},
    {0xAC, (uint8_t[]){0x13, 0x10, 0x01, 0x00, 0x1C, 0x12, 0x02, 0x1B, 0x18, 0x09, 0x19, 0x1A, 0x1B, 0x1B, 0x18, 0x1B,
                       0x0B, 0x11, 0x00, 0x02, 0x1C, 0x0A, 0x02, 0x18, 0x18, 0x08, 0x19, 0x1A, 0x1B, 0x1B, 0x18, 0x1B,
                       0xFF, 0xFF, 0xFF, 0xFF, 0x00}, 37, 0},
    {0xAD, (uint8_t[]){0xCC, 0x40, 0x46, 0x11, 0x04, 0x5C, 0xCF}, 7, 0},
    {0xE8, (uint8_t[]){0x30, 0x07, 0x00, 0xEB, 0xEB, 0x9C, 0x00, 0xE2, 0x04, 0x00, 0x00, 0x00, 0x00, 0xEF}, 14, 0},
    {0xE9, (uint8_t[]){0x3C, 0x7F, 0x08, 0x0C, 0x1A, 0x7A, 0x22, 0x1A, 0x33}, 9, 0},
    {0x75, (uint8_t[]){0x03, 0x04}, 2, 0},
    {0xE7, (uint8_t[]){0x8B, 0x3C, 0x00, 0x0C, 0xF0, 0x5D, 0x00, 0x5D, 0x05, 0x5D, 0x00, 0x5D, 0x00, 0xFF, 0x00, 0x08,
                       0x7B, 0x00, 0x00, 0xC8, 0x6A, 0x5A, 0x08, 0x1A, 0x3C, 0x00, 0x91, 0x01, 0xCC, 0x01, 0x7F, 0xF0,
                       0x22}, 33, 0},
    {0xC8, (uint8_t[]){0x00, 0x00, 0x15, 0x26, 0x44, 0x00, 0x78, 0x03, 0xBE, 0x06, 0x11, 0x1C, 0x09, 0x8A, 0x03, 0x21,
                       0xD4, 0x01, 0x11, 0x0F, 0x22, 0x4A, 0x0F, 0x8F, 0x0A, 0x32, 0xF0, 0x0A, 0x41, 0x0D, 0xF3, 0x80,
                       0x0D, 0xAE, 0xC5, 0x03, 0xC4}, 37, 0},
    {0xC9, (uint8_t[]){0x00, 0x00, 0x15, 0x26, 0x44, 0x00, 0x78, 0x03, 0xBE, 0x06, 0x11, 0x1C, 0x09, 0x8A, 0x03, 0x21,
                       0xD4, 0x01, 0x11, 0x0F, 0x22, 0x4A, 0x0F, 0x8F, 0x0A, 0x32, 0xF0, 0x0A, 0x41, 0x0D, 0xF3, 0x80,
                       0x0D, 0xAE, 0xC5, 0x03, 0xC4}, 37, 0},
    {0x11, NULL, 0, 150},
    {0x29, NULL, 0, 50},
};

static int sdcard_init(void *cfg, int cfg_size, void **handle)
{

    vTaskDelay(pdMS_TO_TICKS(50));
    return dev_fs_fat_init(cfg, cfg_size, handle);
}

esp_err_t esp_board_runtime_pre_init(void)
{
    // The YAML only accepts SDMMC_FREQ_*, so the TF card clock is set here.
    dev_fs_fat_config_t *config;
    ESP_RETURN_ON_ERROR(esp_board_device_get_config(ESP_BOARD_DEVICE_NAME_FS_SDCARD, (void **)&config), TAG, "Get SD config failed");
    dev_fs_fat_config_t sd_config = *config;
    sd_config.frequency = 10000;
    ESP_RETURN_ON_ERROR(esp_board_device_override_config(ESP_BOARD_DEVICE_NAME_FS_SDCARD, &sd_config, sizeof(sd_config)), TAG, "Override SD frequency failed");
    return esp_board_device_set_ops(ESP_BOARD_DEVICE_NAME_FS_SDCARD, sdcard_init, dev_fs_fat_deinit);
}

esp_err_t lcd_dsi_panel_factory_entry_t(esp_lcd_dsi_bus_handle_t dsi_handle, dev_display_lcd_config_t *lcd_cfg, dev_display_lcd_handles_t *lcd_handles)
{
    gpio_config_t io_conf = {
        .pin_bit_mask = (1ULL << LCD_RST_GPIO) | (1ULL << TP_RST_GPIO),
        .mode = GPIO_MODE_OUTPUT,
    };
    gpio_config(&io_conf);
    gpio_set_level(TP_RST_GPIO, 1);

    gpio_set_level(LCD_RST_GPIO, 1);
    vTaskDelay(pdMS_TO_TICKS(100));
    gpio_set_level(LCD_RST_GPIO, 0);
    vTaskDelay(pdMS_TO_TICKS(100));
    gpio_set_level(LCD_RST_GPIO, 1);
    vTaskDelay(pdMS_TO_TICKS(120));

    for (int i = 0; i < sizeof(init_cmds) / sizeof(init_cmds[0]); i++) {
        esp_err_t ret = esp_lcd_panel_io_tx_param(lcd_handles->io_handle, init_cmds[i].cmd, init_cmds[i].data, init_cmds[i].len);
        if (ret != ESP_OK) {
            ESP_LOGE(TAG, "Send ST7102 init cmd 0x%02X failed: %s", init_cmds[i].cmd, esp_err_to_name(ret));
            return ret;
        }
        if (init_cmds[i].delay_ms) {
            vTaskDelay(pdMS_TO_TICKS(init_cmds[i].delay_ms));
        }
    }

    // The board manager calls esp_lcd_panel_init on the returned panel
    esp_err_t ret = esp_lcd_new_panel_dpi(dsi_handle, &lcd_cfg->sub_cfg.dsi.dpi_config, &lcd_handles->panel_handle);
    if (ret != ESP_OK) {
        ESP_LOGE(TAG, "Failed to create DPI panel: %s", esp_err_to_name(ret));
    }
    return ret;
}

#if defined(HAS_ST7123)
esp_err_t lcd_touch_factory_entry_t(esp_lcd_panel_io_handle_t io, const esp_lcd_touch_config_t *touch_dev_config, esp_lcd_touch_handle_t *ret_touch)
{
    esp_err_t ret = esp_lcd_touch_new_i2c_st7123(io, touch_dev_config, ret_touch);
    if (ret != ESP_OK) {
        ESP_LOGE(TAG, "Failed to create st7123 touch driver: %s", esp_err_to_name(ret));
    }
    return ret;
}
#endif
